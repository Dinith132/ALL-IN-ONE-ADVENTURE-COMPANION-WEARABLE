#include <stdio.h>
#include <stdlib.h>
#include <string.h>
#include "freertos/FreeRTOS.h"
#include "freertos/task.h"
#include "esp_log.h"

#include "ssd1306.h"
#include "font8x8_basic.h"

#define I2C_INTERFACE      1  // Set to 1 if using I2C, otherwise 0
#define SPI_INTERFACE      0  // Set to 1 if using SPI, otherwise 0

// I2C Configuration
#define CONFIG_SDA_GPIO           21
#define CONFIG_SCL_GPIO           22
#define CONFIG_RESET_GPIO         -1

double lan = 9.2221 ,lon = 44.2244;
double ht = 95.7 ,s02 = 99.5;


// Display Configuration
#define USE_SSD1306_128x64 1  // Set to 1 for 128x64, otherwise set to 0



#define tag "SSD1306"
uint8_t batman[] = {
// 'OIP', 128x64px
0x00, 0x00, 0x00, 0x00, 0x00, 0x00, 0x00, 0x00, 0x00, 0x00, 0x00, 0x00, 0x00, 0x00, 0x00, 0x00, 
0x00, 0x00, 0x00, 0x00, 0x00, 0x00, 0x00, 0x00, 0x00, 0x00, 0x00, 0x00, 0x00, 0x00, 0x00, 0x00, 
0x00, 0x00, 0x00, 0x00, 0x00, 0x00, 0x00, 0x00, 0x00, 0x00, 0x00, 0x00, 0x00, 0x00, 0x00, 0x00, 
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0x00, 0x00, 0x00, 0x00, 0x00, 0x00, 0x00, 0x00, 0x00, 0x00, 0x00, 0x00, 0x00, 0x00, 0x00, 0x00
};

uint8_t heart[] = {

// 'heart1', 64x32px
0x00, 0x00, 0x00, 0x00, 0x00, 0x00, 0x00, 0x00, 0x00, 0x00, 0x00, 0x00, 0x00, 0x00, 0x00, 0x00, 
0x00, 0x00, 0x00, 0x00, 0x00, 0x00, 0x00, 0x00, 0x00, 0x00, 0x00, 0x00, 0x00, 0x00, 0x00, 0x00, 
0x00, 0x00, 0x00, 0x0d, 0x65, 0x80, 0x00, 0x00, 0x00, 0x00, 0x0d, 0xe9, 0xfe, 0xc0, 0x00, 0x00, 
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0x00, 0x00, 0x00, 0x00, 0x00, 0x00, 0x00, 0x00, 0x00, 0x00, 0x00, 0x00, 0x00, 0x00, 0x00, 0x00, 
};

uint8_t map[]={
// 'map2', 64x32px
0x00, 0x00, 0x00, 0x00, 0x00, 0x00, 0x00, 0x00, 0x00, 0x00, 0x00, 0x00, 0x00, 0x00, 0x00, 0x00, 
0x00, 0x00, 0x00, 0x00, 0x00, 0x00, 0x00, 0x00, 0x00, 0x00, 0x00, 0x00, 0x00, 0x00, 0x00, 0x00, 
0x00, 0x00, 0x00, 0x00, 0x00, 0x00, 0x00, 0x00, 0x00, 0x00, 0x00, 0x00, 0x00, 0x00, 0x00, 0x00, 
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0x00, 0x00, 0x00, 0x00, 0x00, 0x00, 0x00, 0x00, 0x00, 0x00, 0x00, 0x00, 0x00, 0x00, 0x00, 0x00
};

void app_main(void)
{
	SSD1306_t dev;
	int center, top, bottom;
	char lineChar[20];
	
	ESP_LOGI(tag, "---------------OLED Settings------------");
	ESP_LOGI(tag, "CONFIG_SDA_GPIO=%d",CONFIG_SDA_GPIO);
	ESP_LOGI(tag, "CONFIG_SCL_GPIO=%d",CONFIG_SCL_GPIO);
	ESP_LOGI(tag, "CONFIG_RESET_GPIO=%d",CONFIG_SCL_GPIO);
	i2c_master_init(&dev, CONFIG_SDA_GPIO, CONFIG_SCL_GPIO, CONFIG_RESET_GPIO);



	ESP_LOGI(tag, "Panel is 128x64");
	ssd1306_init(&dev, 128, 64);


	
	ssd1306_clear_screen(&dev, false);
	ssd1306_contrast(&dev, 0xff);
// Clear screen
ssd1306_clear_screen(&dev, false);

// Center "AIO" at row 3, aligned for the middle of the screen
ssd1306_display_text_x3(&dev, 2, "A-I-O", 5, false);

// Wait for 2 seconds before proceeding
vTaskDelay(2000 / portTICK_PERIOD_MS);

// Clear screen before showing "Starting..."
ssd1306_clear_screen(&dev, false);
ssd1306_display_text(&dev, 4, "Starting", 8, false);  // Print "Starting" first

// Animate dots one by one over 4 seconds
for (int i = 0; i < 5; i++) {  // 5 dots appear progressively
    char text[14] = "Starting";  // Base text
    for (int j = 0; j <= i; j++) {
        text[8 + j] = '.';  // Add dots progressively
    }
    text[9 + i] = '\0';  // Null-terminate the string
    ssd1306_display_text(&dev, 4, text, 9 + i, false);
    vTaskDelay(800 / portTICK_PERIOD_MS);  // Smooth animation every 800ms
}

// Hold the final message for 2 seconds
vTaskDelay(2000 / portTICK_PERIOD_MS);



	top = 2;
	center = 3;
	bottom = 8;
/*	ssd1306_display_text(&dev, 0, "SSD1306 128x64", 14, false);
	ssd1306_display_text(&dev, 1, "ABCDEFGHIJKLMNOP", 16, false);
	ssd1306_display_text(&dev, 2, "abcdefghijklmnop",16, false);
	ssd1306_display_text(&dev, 3, "Hello World!!", 13, false);
	//ssd1306_clear_line(&dev, 4, true);
	//ssd1306_clear_line(&dev, 5, true);
	//ssd1306_clear_line(&dev, 6, true);
	//ssd1306_clear_line(&dev, 7, true);
	ssd1306_display_text(&dev, 4, "SSD1306 128x64", 14, true);
	ssd1306_display_text(&dev, 5, "ABCDEFGHIJKLMNOP", 16, true);
	ssd1306_display_text(&dev, 6, "abcdefghijklmnop",16, true);
	ssd1306_display_text(&dev, 7, "Hello World!!", 13, true);*/

//vTaskDelay(3000 / portTICK_PERIOD_MS);

		//display batman
	ssd1306_clear_screen(&dev, false);
	
	int xpos = 0;
	int ypos = 0;
	
	// Draw Batman bitmap (full-screen 128x64)
	ssd1306_bitmaps(&dev, xpos, ypos, batman, 128, 64, false);
	vTaskDelay(3000 / portTICK_PERIOD_MS);
	//ssd1306_fadeout(&dev);
	


	
	ssd1306_clear_screen(&dev, false);
	
	// Get OLED display width & height
	int width = ssd1306_get_width(&dev);
	int height = ssd1306_get_height(&dev);
	
	// Display "Heart Rate: 76.45" at the top
	ssd1306_display_text(&dev, 0, "Heart Rate: 76.45", 18, false);
	
	// Calculate position to center the heart bitmap (64x32)
	 xpos = (width - 64) / 2;  // Center horizontally
	 ypos = (height - 32) / 2; // Center vertically (adjusted for text)
	
	// Draw the heart bitmap (64x32)
	ssd1306_bitmaps(&dev, xpos, ypos, heart, 64, 32, false);
	
	// Display "Blood Oxygen: 98.5" at the bottom
	ssd1306_display_text(&dev, 6, "Blood Oxygen:98", 19, false);
	
	// Keep the display for 3 seconds
	vTaskDelay(3000 / portTICK_PERIOD_MS);
	
	// Fade out the screen
	//ssd1306_fadeout(&dev);
	
	
		
	ssd1306_clear_screen(&dev, false);
	
	// Get OLED display width & height
	 width = ssd1306_get_width(&dev);
	 height = ssd1306_get_height(&dev);
	
	// Display "Heart Rate: 76.45" at the top
	ssd1306_display_text(&dev, 0, "Lagntitude: 76.4545", 18, false);
	
	// Calculate position to center the heart bitmap (64x32)
	 xpos = (width - 64) / 2;  // Center horizontally
	 ypos = (height - 32) / 2; // Center vertically (adjusted for text)
	
	// Draw the heart bitmap (64x32)
	ssd1306_bitmaps(&dev, xpos, ypos, map, 64, 32, false);
	
	// Display "Blood Oxygen: 98.5" at the bottom
	ssd1306_display_text(&dev, 6, "Longtitude:9.5543", 19, false);
	
	// Keep the display for 3 seconds
	vTaskDelay(3000 / portTICK_PERIOD_MS);
	
	// Fade out the screen
	//ssd1306_fadeout(&dev);
	
		
/*#if 0
	// Fade Out
	for(int contrast=0xff;contrast>0;contrast=contrast-0x20) {
		ssd1306_contrast(&dev, contrast);
		vTaskDelay(40);
	}
#endif*/


		

/* 
	uint8_t image[24];
	memset(image, 0, sizeof(image));
	ssd1306_display_image(&dev, top, (6*8-1), image, sizeof(image));
	ssd1306_display_image(&dev, top+1, (6*8-1), image, sizeof(image));
	ssd1306_display_image(&dev, top+2, (6*8-1), image, sizeof(image));
	for(int font=0x39;font>0x30;font--) {
		memset(image, 0, sizeof(image));
		ssd1306_display_image(&dev, top+1, (7*8-1), image, 8);
		memcpy(image, font8x8_basic_tr[font], 8);
		if (dev._flip) ssd1306_flip(image, 8);
		ssd1306_display_image(&dev, top+1, (7*8-1), image, 8);
		vTaskDelay(1000 / portTICK_PERIOD_MS);
	}
	
	// Scroll Up
	ssd1306_clear_screen(&dev, false);
	ssd1306_contrast(&dev, 0xff);
	ssd1306_display_text(&dev, 0, "---Scroll  UP---", 16, true);
	//ssd1306_software_scroll(&dev, 7, 1);
	ssd1306_software_scroll(&dev, (dev._pages - 1), 1);
	for (int line=0;line<bottom+10;line++) {
		lineChar[0] = 0x01;
		sprintf(&lineChar[1], " Line %02d", line);
		ssd1306_scroll_text(&dev, lineChar, strlen(lineChar), false);
		vTaskDelay(500 / portTICK_PERIOD_MS);
	}
	vTaskDelay(3000 / portTICK_PERIOD_MS);
	
	// Scroll Down
	ssd1306_clear_screen(&dev, false);
	ssd1306_contrast(&dev, 0xff);
	ssd1306_display_text(&dev, 0, "--Scroll  DOWN--", 16, true);
	//ssd1306_software_scroll(&dev, 1, 7);
	ssd1306_software_scroll(&dev, 1, (dev._pages - 1) );
	for (int line=0;line<bottom+10;line++) {
		lineChar[0] = 0x02;
		sprintf(&lineChar[1], " Line %02d", line);
		ssd1306_scroll_text(&dev, lineChar, strlen(lineChar), false);
		vTaskDelay(500 / portTICK_PERIOD_MS);
	}
	vTaskDelay(3000 / portTICK_PERIOD_MS);

	// Page Down
	ssd1306_clear_screen(&dev, false);
	ssd1306_contrast(&dev, 0xff);
	ssd1306_display_text(&dev, 0, "---Page	DOWN---", 16, true);
	ssd1306_software_scroll(&dev, 1, (dev._pages-1) );
	for (int line=0;line<bottom+10;line++) {
		//if ( (line % 7) == 0) ssd1306_scroll_clear(&dev);
		if ( (line % (dev._pages-1)) == 0) ssd1306_scroll_clear(&dev);
		lineChar[0] = 0x02;
		sprintf(&lineChar[1], " Line %02d", line);
		ssd1306_scroll_text(&dev, lineChar, strlen(lineChar), false);
		vTaskDelay(500 / portTICK_PERIOD_MS);
	}
	vTaskDelay(3000 / portTICK_PERIOD_MS);

	// Horizontal Scroll
	ssd1306_clear_screen(&dev, false);
	ssd1306_contrast(&dev, 0xff);
	ssd1306_display_text(&dev, center, "Horizontal", 10, false);
	ssd1306_hardware_scroll(&dev, SCROLL_RIGHT);
	vTaskDelay(5000 / portTICK_PERIOD_MS);
	ssd1306_hardware_scroll(&dev, SCROLL_LEFT);
	vTaskDelay(5000 / portTICK_PERIOD_MS);
	ssd1306_hardware_scroll(&dev, SCROLL_STOP);
	
	// Vertical Scroll
	ssd1306_clear_screen(&dev, false);
	ssd1306_contrast(&dev, 0xff);
	ssd1306_display_text(&dev, center, "Vertical", 8, false);
	ssd1306_hardware_scroll(&dev, SCROLL_DOWN);
	vTaskDelay(5000 / portTICK_PERIOD_MS);
	ssd1306_hardware_scroll(&dev, SCROLL_UP);
	vTaskDelay(5000 / portTICK_PERIOD_MS);
	ssd1306_hardware_scroll(&dev, SCROLL_STOP);
	
	// Invert
	ssd1306_clear_screen(&dev, true);
	ssd1306_contrast(&dev, 0xff);
	ssd1306_display_text(&dev, center, "Pankaja", 12, true);
	vTaskDelay(5000 / portTICK_PERIOD_MS);

*/
	// Fade Out
	//ssd1306_fadeout(&dev);
	
#if 0
	// Fade Out
	for(int contrast=0xff;contrast>0;contrast=contrast-0x20) {
		ssd1306_contrast(&dev, contrast);
		vTaskDelay(40);
	}
#endif

	// Restart module
	esp_restart();
}
